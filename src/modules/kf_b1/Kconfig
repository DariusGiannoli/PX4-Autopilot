## src/modules/kf_b1/Kconfig
```kconfig
menuconfig MODULES_KF_B1
	bool "kf_b1"
	default n
	---help---
		Enable support for kf_b1 (online Kalman-filter estimate of the control-effectiveness matrix B1)
```

## src/modules/throw_sysid/Kconfig
```kconfig
menuconfig MODULES_THROW_SYSID
	bool "throw_sysid"
	default n
	---help---
		Enable support for throw_sysid (per-motor hover pulses added to the motor commands, for kf_b1)
```
